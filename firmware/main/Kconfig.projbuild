## firmware/main/Kconfig.projbuild
```kconfig
menu "Pocket Squatch"

    choice SQUATCH_BOARD
        prompt "Board"
        default SQUATCH_BOARD_LCD_4B
        help
            Which Waveshare board this build is for. The game draws the same 480x480
            picture on both; the AMOLED shows it scaled to fit its narrower screen.

        config SQUATCH_BOARD_LCD_4B
            bool "ESP32-S3-Touch-LCD-4B (4 inch, 480x480)"

        config SQUATCH_BOARD_AMOLED_18
            bool "ESP32-S3-Touch-AMOLED-1.8 (1.8 inch, 368x448, picture scaled)"

        config SQUATCH_BOARD_AMOLED_175
            bool "ESP32-S3-Touch-AMOLED-1.75C (1.75 inch round, 466x466, round layout)"
    endchoice

    choice SQUATCH_PET
        prompt "Pet"
        default SQUATCH_PET_SQUATCH
        help
            Which animal the game is about: the Squatch in its forest clearing, or the
            horse edition, a foal in a paddock that grows into a horse (a rare one is a
            unicorn). Switching it doesn't change a saved pet's stats, only how it's drawn.

        config SQUATCH_PET_SQUATCH
            bool "Squatch (a baby Bigfoot)"

        config SQUATCH_PET_HORSE
            bool "Horse (the horse and unicorn edition)"
    endchoice

    config SQUATCH_WIFI_SSID
        string "Wi-Fi network name (for the clock and the weather)"
        default ""
        help
            The network the board joins for a few seconds at a time: at start-up to set
            the clock, and about once an hour for the weather. Wi-Fi is switched off
            again in between. Leave empty to rely on the board's battery-backed clock
            alone (and no weather). The name must match exactly, capitals included.

    config SQUATCH_WIFI_PASSWORD
        string "Wi-Fi password"
        default ""
        help
            A starting network. On the board, Settings > Wi-Fi > Set up chooses one from a
            phone instead, and that one is used from then on.

    config SQUATCH_TRAILS
        bool "Trail map: listen for nearby Wi-Fi networks"
        default y
        help
            Opening the trail map scans for nearby networks (without joining any) and
            turns each one into a place in the forest. Only a hash of each network's
            name is kept. Wi-Fi is on only for the two seconds of the scan.

    config SQUATCH_WEATHER
        bool "Weather: show the real weather in the clearing"
        default y
        help
            About once an hour the board joins the Wi-Fi network above for a few seconds
            and asks Open-Meteo (api.open-meteo.com, free, no account) for the current
            weather at the place below. Rain, snow, fog, clouds and storms then show in
            the clearing. Needs the Wi-Fi network and a location.

    config SQUATCH_TOWN
        string "Town (for the weather and the clock)"
        depends on SQUATCH_WEATHER
        default ""
        help
            A town name, e.g. "Colorado Springs" or "Leeds, England". The first time the board
            is online it looks the town up (Open-Meteo's free geocoding), and from then on the
            weather is for there and the clock keeps its time zone. The setup page (Settings >
            Wi-Fi) can change it later. Leave it empty to use the latitude, longitude and time
            zone below.

    config SQUATCH_WEATHER_LAT
        string "Weather location: latitude"
        depends on SQUATCH_WEATHER
        default ""
        help
            Decimal degrees, north positive, e.g. 38.83. A town's coordinates are
            plenty: look the town up on a map. Leave empty for no weather.

    config SQUATCH_WEATHER_LON
        string "Weather location: longitude"
        depends on SQUATCH_WEATHER
        default ""
        help
            Decimal degrees, east positive (so negative in the Americas), e.g. -104.82.

    config SQUATCH_FAHRENHEIT
        bool "Show temperatures in Fahrenheit"
        default y

    config SQUATCH_SLEEP
        bool "Sleep while the screen is off"
        default y
        select PM_ENABLE
        select FREERTOS_USE_TICKLESS_IDLE
        select USJ_NO_AUTO_LS_ON_CONNECTION
        help
            With the screen off, the processor slows down and naps between checks for a
            touch or the power key (automatic light sleep), and the AMOLED panel goes
            into its own sleep. While a computer's serial monitor is connected over USB
            it stays awake, so the log keeps working.

    config SQUATCH_TZ
        string "Time zone (POSIX TZ string)"
        default "MST7MDT,M3.2.0,M11.1.0"
        help
            Decides when it's bedtime and when the sky gets dark. Examples:
            "EST5EDT,M3.2.0,M11.1.0" (US Eastern), "GMT0BST,M3.5.0/1,M10.5.0" (UK),
            "CET-1CEST,M3.5.0,M10.5.0/3" (Central Europe).

    config SQUATCH_OTA
        bool "Automatic updates over Wi-Fi"
        default y
        help
            Once a night (around 3 am, with the screen off and enough battery or on the
            charger) the board looks for a newer build of itself and installs it; Settings >
            Wi-Fi can also check right away. Builds come from this repo's "firmware" release,
            which CI keeps up to date. The pet, its settings, the Wi-Fi and the town are kept.
            A build you make yourself is version 0, so the next update replaces it: turn this
            off while developing.

    config SQUATCH_OTA_URL
        string "Where updates come from"
        depends on SQUATCH_OTA
        default "https://github.com/ceruleanscarab/pocket-squatch/releases/download/firmware/"
        help
            A folder of builds, one per edition and board, named like pony-amoled18.bin.

    config SQUATCH_CLOUD_URL
        string "Cloud backups address"
        default ""
        help
            The Cloudflare Worker in cloud/ (see cloud/README.md), ending in /v1/save/. With it
            set, the board backs its pet up once a night and after Wi-Fi setup, and shows its
            backup code under Settings > Wi-Fi; the setup page can bring a pet back from a code.
            Empty: no backups.

endmenu
```
