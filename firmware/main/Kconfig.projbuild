## firmware/main/Kconfig.projbuild
```kconfig
menu "Pocket Squatch"

    choice SQUATCH_BOARD
        prompt "Board"
        default SQUATCH_BOARD_LCD_4B
        help
            Which Waveshare board this build is for. The game draws the same 480x480
            picture on both; the AMOLED shows it scaled to fit its narrower screen.

        config SQUATCH_BOARD_LCD_4B
            bool "ESP32-S3-Touch-LCD-4B (4 inch, 480x480)"

        config SQUATCH_BOARD_AMOLED_18
            bool "ESP32-S3-Touch-AMOLED-1.8 (1.8 inch, 368x448, picture scaled)"
    endchoice

    config SQUATCH_WIFI_SSID
        string "Wi-Fi network name (for the clock and the weather)"
        default ""
        help
            The network the board joins for a few seconds at a time: at start-up to set
            the clock, and about once an hour for the weather. Wi-Fi is switched off
            again in between. Leave empty to rely on the board's battery-backed clock
            alone (and no weather). The name must match exactly, capitals included.

    config SQUATCH_WIFI_PASSWORD
        string "Wi-Fi password"
        default ""

    config SQUATCH_TRAILS
        bool "Trail map: listen for nearby Wi-Fi networks"
        default y
        help
            Opening the trail map scans for nearby networks (without joining any) and
            turns each one into a place in the forest. Only a hash of each network's
            name is kept. Wi-Fi is on only for the two seconds of the scan.

    config SQUATCH_WEATHER
        bool "Weather: show the real weather in the clearing"
        default y
        help
            About once an hour the board joins the Wi-Fi network above for a few seconds
            and asks Open-Meteo (api.open-meteo.com, free, no account) for the current
            weather at the place below. Rain, snow, fog, clouds and storms then show in
            the clearing. Needs the Wi-Fi network and a location.

    config SQUATCH_WEATHER_LAT
        string "Weather location: latitude"
        depends on SQUATCH_WEATHER
        default ""
        help
            Decimal degrees, north positive, e.g. 38.83. A town's coordinates are
            plenty: look the town up on a map. Leave empty for no weather.

    config SQUATCH_WEATHER_LON
        string "Weather location: longitude"
        depends on SQUATCH_WEATHER
        default ""
        help
            Decimal degrees, east positive (so negative in the Americas), e.g. -104.82.

    config SQUATCH_FAHRENHEIT
        bool "Show temperatures in Fahrenheit"
        default y

    config SQUATCH_SLEEP
        bool "Sleep while the screen is off"
        default y
        select PM_ENABLE
        select FREERTOS_USE_TICKLESS_IDLE
        select USJ_NO_AUTO_LS_ON_CONNECTION
        help
            With the screen off, the processor slows down and naps between checks for a
            touch or the power key (automatic light sleep), and the AMOLED panel goes
            into its own sleep. While a computer's serial monitor is connected over USB
            it stays awake, so the log keeps working.

    config SQUATCH_TZ
        string "Time zone (POSIX TZ string)"
        default "MST7MDT,M3.2.0,M11.1.0"
        help
            Decides when it's bedtime and when the sky gets dark. Examples:
            "EST5EDT,M3.2.0,M11.1.0" (US Eastern), "GMT0BST,M3.5.0/1,M10.5.0" (UK),
            "CET-1CEST,M3.5.0,M10.5.0/3" (Central Europe).

endmenu
```
